## main/Kconfig.projbuild
```kconfig
menu "BikePower 板型配置"

    choice BOARD_TYPE
        prompt "目标板型"
        default BOARD_AUTO_DETECT
        help
            选择目标硬件板型。自动检测通过 GPIO3 下拉电平判断：
            M5Stamp C3 GPIO3 接按钮上拉 → 高电平；
            通用板 GPIO3 悬空 → 低电平。
            若自动检测误判，可手动指定。

        config BOARD_AUTO_DETECT
            bool "自动检测"
        config BOARD_GENERIC_C3
            bool "通用 ESP32-C3（合宙简约版等，GPIO12 LED + GPIO9 按钮）"
        config BOARD_M5STAMP_C3
            bool "M5Stamp C3（GPIO2 SK6812 RGB LED + GPIO3 按钮）"
    endchoice

endmenu
```

## sdkconfig.defaults
```kconfig
# BikePower C — ESP-IDF v5.5.4 默认裁剪配置
# 目标芯片
CONFIG_IDF_TARGET="esp32c3"

# 分区表（4MB Flash 单 app 布局：factory + nvs/phy/coredump，无 OTA）
CONFIG_PARTITION_TABLE_CUSTOM=y
CONFIG_PARTITION_TABLE_CUSTOM_FILENAME="partitions.csv"
CONFIG_ESPTOOLPY_FLASHSIZE="4MB"
CONFIG_ESPTOOLPY_FLASHSIZE_4MB=y

# BLE：使用 NimBLE，关闭 Bluedroid
CONFIG_BT_ENABLED=y
CONFIG_BT_NIMBLE_ENABLED=y
CONFIG_BT_NIMBLE_ROLE_PERIPHERAL=y
CONFIG_BT_NIMBLE_ROLE_CENTRAL=y
CONFIG_BT_NIMBLE_ROLE_BROADCASTER=y
CONFIG_BT_NIMBLE_ROLE_OBSERVER=y
CONFIG_BT_NIMBLE_MAX_CONNECTIONS=2
CONFIG_BT_NIMBLE_MAX_BONDS=0
CONFIG_BT_NIMBLE_MAX_CCCDS=8
CONFIG_BT_NIMBLE_GATT_CLIENT=y
CONFIG_BT_NIMBLE_GATT_SERVER=y
CONFIG_BT_NIMBLE_NVS_PERSIST=n
CONFIG_BT_NIMBLE_HS_PVCY=n
CONFIG_BT_NIMBLE_ATT_PREFERRED_MTU=64
CONFIG_BT_NIMBLE_HOST_TASK_STACK_SIZE=4096

# 日志：发版默认 WARN，临时诊断才提升 INFO/DEBUG
CONFIG_LOG_DEFAULT_LEVEL_WARN=y

# 看门狗
CONFIG_ESP_TASK_WDT_EN=y
CONFIG_ESP_TASK_WDT_TIMEOUT_S=5
CONFIG_ESP_TASK_WDT_CHECK_IDLE_TASK_CPU0=y

# Coredump：崩溃栈回溯写入 flash 分区，便于发版后排障
CONFIG_ESP_COREDUMP_ENABLE_TO_FLASH=y
CONFIG_ESP_COREDUMP_DATA_FORMAT_ELF=y
CONFIG_ESP_COREDUMP_CHECKSUM_CRC32=y
CONFIG_ESP_COREDUMP_STACK_SIZE=1024

# 编译优化（减体积）
CONFIG_COMPILER_OPTIMIZATION_SIZE=y

# 固件加固（方案C：零硬件风险的编译层措施，不烧 eFuse、不影响串口排障）
# Silent assert：去掉 assert 中的 __FILE__/行号明文字符串，
# 抬高反编译门槛同时减小体积；触发时仅 abort 无信息。
CONFIG_COMPILER_OPTIMIZATION_ASSERTIONS_SILENT=y
# 关闭 bootloader 日志：不再打印分区/版本等启动信息。
CONFIG_BOOTLOADER_LOG_LEVEL_NONE=y
CONFIG_BOOTLOADER_LOG_LEVEL=0

# WiFi：仅 AP，缩小缓冲池省内存
CONFIG_ESP_COEX_SW_COEXIST_ENABLE=y
CONFIG_ESP_WIFI_SOFTAP_SUPPORT=y
CONFIG_ESP_WIFI_STATIC_RX_BUFFER_NUM=4
CONFIG_ESP_WIFI_DYNAMIC_RX_BUFFER_NUM=8

# HTTP server：配网页只服务 1-2 个手机连接
# 请求头缓冲需覆盖手机浏览器完整请求头（UA+Accept 系列+Origin 等），
# 1024 会触发 HTTP 431 "Header fields are too long"，故放大到 2048。
CONFIG_HTTPD_MAX_REQ_HDR_LEN=2048
CONFIG_HTTPD_MAX_URI_LEN=128

# 板型：通用 ESP32-C3 开发板（GPIO12 LED, GPIO9 按钮）
CONFIG_BOARD_GENERIC_C3=y

# 编译加速：ccache 缓存编译结果，增量编译快 50-80%
# 首次编译无加速（填缓存），后续编译命中缓存跳过编译
# 需要先安装 ccache（ESP-IDF install.ps1 会自动安装）
CONFIG_CCACHE_ENABLE=y

# 构建系统：Ninja（默认，比 Make 快很多）
# IDF_BUILD_SYSTEM_NINJA=y  # ESP-IDF v5.5+ 默认使用 Ninja
```
